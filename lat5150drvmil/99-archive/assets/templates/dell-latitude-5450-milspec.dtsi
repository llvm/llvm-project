/* dell-latitude-5450-milspec.dtsi */
/ {
    milspec_gpio: gpio@fed40000 {
        compatible = "dell,milspec-gpio";
        reg = <0xfed40000 0x1000>;
        
        mode5-tp-gpio = <&gpio 147 GPIO_ACTIVE_HIGH>;
        paranoid-tp-gpio = <&gpio 148 GPIO_ACTIVE_HIGH>;
        service-gpio = <&gpio 245 GPIO_ACTIVE_LOW>;
        intrusion-gpio = <&gpio 384 GPIO_ACTIVE_HIGH>;
        tamper-gpio = <&gpio 385 GPIO_ACTIVE_HIGH>;
    };
};
